## main/Kconfig.projbuild
```kconfig
menu "Application Configuration"

config LWM2M_SERVER_URI
    string "LwM2M server URI"
    default "coaps://thingsboard.example.com:5686"
    help
        Replace the example hostname with your server. DTLS is required.
        Use the hostname in the server certificate.

config LWM2M_ENDPOINT
    string "LwM2M endpoint and device certificate CN"
    default "esp32-dht11-01"
    help
        Must match the existing ThingsBoard endpoint and device certificate CN.

config DHT11_GPIO
    int "DHT11 data GPIO"
    range 0 33
    default 23
    help
        Select an available output-capable GPIO. Do not use flash, UART,
        or boot-strapping pins without checking the board wiring.

config TIME_SERVER
    string "NTP server used before TLS startup"
    default "time.cloudflare.com"
    help
        Use a reachable internal NTP service here if public UDP/123 is blocked.
        LwM2M remains stopped until initial synchronization succeeds.

config REPROVISION_GPIO
    int "Active-low Wi-Fi reset button GPIO"
    range 0 33
    default 0
    help
        The ESP32 BOOT button uses GPIO 0. After boot, hold for five seconds
        to clear only Wi-Fi configuration and restart into BLE provisioning.

config TELEMETRY_INTERVAL_SECONDS
    int "Sensor sampling and telemetry interval (seconds)"
    range 3 3600
    default 5
    help
        DHT11 reads must be more than two seconds apart. Failed samples are
        skipped; the same interval applies before trying again.

endmenu
```

## tests/esp32_dtls/sdkconfig.defaults
```kconfig
CONFIG_IDF_TARGET="esp32"
CONFIG_ESPTOOLPY_FLASHSIZE_4MB=y
CONFIG_PARTITION_TABLE_CUSTOM=y
CONFIG_PARTITION_TABLE_CUSTOM_FILENAME="../../partitions.csv"
CONFIG_COMPILER_OPTIMIZATION_ASSERTIONS_ENABLE=y
CONFIG_ESP_MAIN_TASK_STACK_SIZE=16384
CONFIG_MBEDTLS_SSL_PROTO_DTLS=y
CONFIG_MBEDTLS_HAVE_TIME_DATE=y
CONFIG_MBEDTLS_X509_CREATE_C=y
CONFIG_MBEDTLS_X509_CRT_WRITE_C=y
CONFIG_LWIP_NETIF_LOOPBACK=y
CONFIG_ANJAY_LIBRARY_WITH_TRACE_LOGS=n
CONFIG_ANJAY_WITH_DOWNLOADER=n
CONFIG_ANJAY_WITH_MODULE_FW_UPDATE=n
CONFIG_ANJAY_WITH_MODULE_ADVANCED_FW_UPDATE=n
CONFIG_ANJAY_WITH_MODULE_SW_MGMT=n
CONFIG_ANJAY_WITH_BOOTSTRAP=n
CONFIG_ANJAY_WITH_LWM2M11=n
CONFIG_ANJAY_WITH_MODULE_IPSO_OBJECTS=n
CONFIG_ANJAY_WITH_THREAD_SAFETY=n
```
